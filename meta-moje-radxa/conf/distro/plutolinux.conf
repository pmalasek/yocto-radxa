## meta-moje-radxa/conf/distro/plutolinux.conf
```bitbake
# PlutoLinux Distribution Configuration
# Based on Poky (Yocto Project Reference Distro)

require conf/distro/poky.conf

DISTRO = "plutolinux"
DISTRO_NAME = "PlutoLinux"
DISTRO_VERSION = "1.0"
DISTRO_CODENAME = "pluto"

TARGET_VENDOR = "-plutolinux"

# Switch init manager from SysVinit to systemd
DISTRO_FEATURES:remove = "sysvinit alsa pam"
DISTRO_FEATURES:append = " systemd wifi bluetooth"
INIT_MANAGER = "systemd"

# Set root password (hash of: ATXGroup.2026)
# Generated with: openssl passwd -6 "ATXGroup.2026"
INHERIT += "extrausers"

# Add admin tooling and users
IMAGE_INSTALL:append = " sudo"

# xsystem password hash generated with: openssl passwd -6 "okinawa"
EXTRA_USERS_PARAMS = " \
	usermod -p '\$6\$wnvRwZ7gwXl8.4.J\$4PgX4Yh4DBvY9ub5gNGs/o1bwZsHKlAU4wStKbLh9ZayW52w79TJ/igEmgtYg5e1dgYf5jeatdQz8F3oRO4Lp/' root; \
	groupadd admins; \
	useradd -m -s /bin/sh -G admins -p '\$6\$QhdLUD51NVrW9Byt\$f8chbK0.bzreDz3MYt21m94Rcqtsd7cZY.9/5SkPO4BRdMe8GCVUCXcO/m7GwHfZHfTrgHwBSVA/e/A8ex4Lm0' xsystem; \
"

# Kompatibilní verze knihoven pro prebuilt xPluto9 binárky
PREFERRED_VERSION_fmt = "9.1.0"
PREFERRED_VERSION_spdlog = "1.12.0"
PREFERRED_VERSION_cnats = "3.7.0"
```

## meta-moje-radxa/conf/layer.conf
```bitbake
# We have a conf and classes directory, add to BBPATH
BBPATH .= ":${LAYERDIR}"

# We have recipes-* directories, add to BBFILES
BBFILES += "${LAYERDIR}/recipes-*/*/*.bb \
            ${LAYERDIR}/recipes-*/*/*.bbappend"

BBFILE_COLLECTIONS += "meta-moje-radxa"
BBFILE_PATTERN_meta-moje-radxa = "^${LAYERDIR}/"
BBFILE_PRIORITY_meta-moje-radxa = "6"

LAYERDEPENDS_meta-moje-radxa = "core"
LAYERSERIES_COMPAT_meta-moje-radxa = "scarthgap"
```
