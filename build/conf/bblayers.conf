## build/conf/bblayers.conf
```bitbake
# POKY_BBLAYERS_CONF_VERSION is increased each time build/conf/bblayers.conf
# changes incompatibly
POKY_BBLAYERS_CONF_VERSION = "2"

BBPATH = "${TOPDIR}"
BBFILES ?= ""

BBLAYERS ?= " \
  /home/pmalasek/src/linux/yocto-radxa/poky/meta \
  /home/pmalasek/src/linux/yocto-radxa/poky/meta-poky \
  /home/pmalasek/src/linux/yocto-radxa/poky/meta-yocto-bsp \
  /home/pmalasek/src/linux/yocto-radxa/meta-openembedded/meta-oe \
  /home/pmalasek/src/linux/yocto-radxa/meta-openembedded/meta-python \
  /home/pmalasek/src/linux/yocto-radxa/meta-openembedded/meta-networking \
  /home/pmalasek/src/linux/yocto-radxa/meta-meson \
  /home/pmalasek/src/linux/yocto-radxa/meta-moje-radxa \
  "
```
